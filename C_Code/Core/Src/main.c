/* USER CODE BEGIN Header */
/**
  **************************
  * @file           : main.c
  * @brief          : Main program body
  **************************
  * @attention
  *
  * Copyright (c) 2023 STMicroelectronics.
  * All rights reserved.
  *
  * This software is licensed under terms that can be found in the LICENSE file
  * in the root directory of this software component.
  * If no LICENSE file comes with this software, it is provided AS-IS.
  *
  **************************
  */
/* USER CODE END Header */
/* Includes ------------------------------------------------------------------*/
#include "main.h"

/* Private includes ----------------------------------------------------------*/
/* USER CODE BEGIN Includes */
#include "wm8994.h"
//#include <cmath>
/* USER CODE END Includes */

/* Private typedef -----------------------------------------------------------*/
/* USER CODE BEGIN PTD */
/* USER CODE END PTD */

/* Private define ------------------------------------------------------------*/
/* USER CODE BEGIN PD */
#define AUDIO_I2C_ADDRESS		(uint16_t)0x34

#define INPUT_SAMPLE_SIZE		1000
#define INPUT_SAMPLE_HALF_SIZE	500

#define FIRST_HALF_IS_READY		1
#define FIRST_HALF_IS_READ		2
#define SECOND_HALF_IS_READY	3
#define SECOND_HALF_IS_READ		4


/* USER CODE END PD */

/* Private macro -------------------------------------------------------------*/
/* USER CODE BEGIN PM */
/* USER CODE END PM */

/* Private variables ---------------------------------------------------------*/

I2C_HandleTypeDef hi2c3;

SAI_HandleTypeDef hsai_BlockA2;
SAI_HandleTypeDef hsai_BlockB2;
DMA_HandleTypeDef hdma_sai2_a;
DMA_HandleTypeDef hdma_sai2_b;

/* USER CODE BEGIN PV */


/* USER CODE END PV */

/* Private function prototypes -----------------------------------------------*/
void SystemClock_Config(void);
void PeriphCommonClock_Config(void);
static void MX_GPIO_Init(void);
static void MX_DMA_Init(void);
static void MX_SAI2_Init(void);
static void MX_I2C3_Init(void);
/* USER CODE BEGIN PFP */

/* USER CODE END PFP */

/* Private user code ---------------------------------------------------------*/
/* USER CODE BEGIN 0 */
I2C_HandleTypeDef hi2c3;

SAI_HandleTypeDef hsai_BlockA2;
SAI_HandleTypeDef hsai_BlockB2;
DMA_HandleTypeDef hdma_sai2_a;
DMA_HandleTypeDef hdma_sai2_b;

/* USER CODE BEGIN PV */
int16_t inputBuffer_LeftRightChannel[INPUT_SAMPLE_SIZE];
int16_t outputBuffer_LeftRightChannel[INPUT_SAMPLE_SIZE];

int16_t workingBuffer_LeftChannel[INPUT_SAMPLE_SIZE];
int16_t workingBuffer_RightChannel[INPUT_SAMPLE_SIZE];

uint16_t whatIsReady = 0;

//Modulationen - keine Funktionen, da kurzer Code!
float lut_sin_6[6] = { 0.000000,-0.866025,-0.866025,-0.000000,0.866025,0.866025 }; //gespiegelt an Y Achse
float lut_cos_6[6] = { 1.000000, 0.500000, -0.500000, -1.000000, -0.500000, 0.500000 };
float lut_cos_48[48] = { 1.000000, 0.991445, 0.965926, 0.923880, 0.866025, 0.793353, 0.707107, 0.608761, 0.500000, 0.382683, 0.258819, 0.130526, -0.000000,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 0.965926, 0.991445 };
float lut_sin_48[48] = { 0.000000, 0.130526, 0.258819, 0.382683, 0.500000, 0.608761, 0.707107, 0.793353, 0.866025, 0.923880, 0.965926, 0.991445, 1.000000,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 -0.258819, -0.130526 };
int lut_ptr_6 = 0;
int lut_ptr_48 = 0;

//FIR 2k Filter globale Variablen
#define len2k 56
float fir_2k[len2k] = { -0.0187104623152347,-0.00678439013887772,-0.00767414302014404,-0.00837567469232474,-0.00881388059621414,-0.00893105725390912,-0.00866134876198391,-0.00795865346172748,-0.00677049520679673,-0.00506489863911246,-0.00281724404542476,-3.88763191139820e-05,0.00326288722628858,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-0.00678439013887772,-0.0187104623152347 };
float circular_buffer_2k_real[len2k] = { 0,0,0,0,0,0,0,0,0,0,0,0,0,0,0,0,0,0,0,0,0,0,0,0,0,0,0,0,0,0,0,0,0,0,0,0,0,0,0,0,0,0,0,0,0,0,0,0,0,0,0,0,0,0,0,0};
float circular_buffer_2k_imag[len2k] = { 0,0,0,0,0,0,0,0,0,0,0,0,0,0,0,0,0,0,0,0,0,0,0,0,0,0,0,0,0,0,0,0,0,0,0,0,0,0,0,0,0,0,0,0,0,0,0,0,0,0,0,0,0,0,0,0 };
int pointer_2k_real = 0;
int pointer_2k_imag = 0;
//FIR 2k Filter Funktion
float conv_fir_2k_real(float new_sample);
float conv_fir_2k_imag(float new_sample);

//FIR 200 Filter globale Variablen
//#define len200 61
//float fir_200[len200] = { -0.00454659156989561,0.00237381346541819,0.00279702041514424,0.00355700705627707,0.00440614384270773,0.00510782698903328,0.00544098463625590,0.00521200740140231,0.00427733765899037,0.00256549484022072,9.75619538657715e-05,-0.00299904467586535,-0.00648821331899229,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0.00237381346541819,-0.00454659156989561 };
//#define len200 175
//float fir_200[len200] = {-0.0969179760798744,0.00120240274890306,0.00120852475261654,0.00122373498698943,0.00124685545841525,0.00127926104621318,0.00131958773138570,0.00136909647512007,0.00142553574781152,0.00149070366323866,0.00156111132078175,0.00164029258339884,0.00172284778665574,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0.00120240274890306,-0.0969179760798744};
//#define len200 105
//float fir_200[len200] = {0.0531875555544372,-0.00235797244045878,-0.00246360110524786,-0.00266546728550512,-0.00295328558223856,-0.00331696348043058,-0.00375339492324450,-0.00424078089814559,-0.00477245280151154,-0.00532997027908197,-0.00589870805324862,-0.00646467695451161,-0.00700731048834239,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-0.00235797244045878,0.0531875555544372};
#define len200 301
float fir_200[len200] = {0.00215889711900445,7.21385485677508e-06,-2.97375254127041e-06,-1.98062625006113e-05,-4.30396967292701e-05,-7.23009471068618e-05,-0.000107080064257802,-0.000146733115342469,-0.000190489795491180,-0.000237460988716824,-0.000286646061000466,-0.000336942353306311,-0.000387158714540634,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7.21385485677508e-06,0.00215889711900445};
float circular_buffer_200_real[len200];// = { 0,0,0,0,0,0,0,0,0,0,0,0,0,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0,0 };
int pointer_200_real = 0;
float circular_buffer_200_imag[len200];// = { 0,0,0,0,0,0,0,0,0,0,0,0,0,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0,0 };
int pointer_200_imag = 0;
//FIR 200 Filter Funktion
float conv_fir_200_real(float new_sample);
float conv_fir_200_imag(float new_sample);

//FIR Upsample Filter globale Variablen
//#define lenupsample 15
//float fir_upsample[lenupsample] = { 0.00105485552937794,0.00649758313280937,0.0208719769846060,0.0481237154489847,0.0872643230567969,0.130482775357074,0.164770135023680,0.177881407665308,0.164770135023680,0.130482775357074,0.0872643230567969,0.0481237154489847,0.0208719769846060,0.00649758313280937,0.00105485552937794 };
#define lenupsample 81
float fir_upsample[lenupsample] = {0.00356264145018939,-0.00841369375505002,-0.00519091436571288,-0.00399672292365714,-0.00292607883927117,-0.00140712190382693,0.000560420747075805,0.00268635267122410,0.00453051135123346,0.00563167896826035,0.00561727238237205,0.00431701777828635,0.00182345435971951,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-0.00841369375505002,0.00356264145018939};
float circular_buffer_upsample[lenupsample];// = { 0,0,0,0,0,0,0,0,0,0,0,0,0,0,0 };
int pointer_upsample = 0;
//FIR Upsample Filter Funktion
float conv_fir_upsample(float new_sample);

//Betragsquadraht
float abs(float real, float imag);

//Downsamplung
#define down_len 4
float downsample[125];
int pointer_down_sample = 0;

//PLL
float pll(float input);
float lut_sin_6k[6000] = {0.000000, 0.000524, 0.001047, 0.001571, 0.002094, 0.002618, 0.003142, 0.003665, 0.004189, 0.004712, 0.005236, 0.005760, 0.006283,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 0.001047, 0.000524};
int lut_ptr_pll = 0;
float phi = 0;
#define lut_pll_step 1000
//float last_value = 0;
int inSecondHalf = 0;

//Nur zum "Debuggen" - an Oszi anschauen
float input_pll;
/* USER CODE END 0 */

/**
  * @brief  The application entry point.
  * @retval int
  */
int main(void)
{
  /* USER CODE BEGIN 1 */
	//

  /* USER CODE END 1 */

  /* Enable I-Cache---------------------------------------------------------*/
  SCB_EnableICache();

  /* Enable D-Cache---------------------------------------------------------*/
  SCB_EnableDCache();

  /* MCU Configuration--------------------------------------------------------*/

  /* Reset of all peripherals, Initializes the Flash interface and the Systick. */
  HAL_Init();

  /* USER CODE BEGIN Init */
  for (uint16_t i = 0; i < INPUT_SAMPLE_SIZE; i++){
	  inputBuffer_LeftRightChannel[i] = 0;
	  outputBuffer_LeftRightChannel[i] = 0;
  }
  for (uint16_t i = 0; i < INPUT_SAMPLE_SIZE; i++){
	  workingBuffer_LeftChannel[i] = 0;
	  workingBuffer_RightChannel[i] = 0;
  }
  for (int i = 0; i < len200; i++)
  {
	  circular_buffer_200_imag[i] = 0;
	  circular_buffer_200_real[i] = 0;
  }

  for (int i = 0; i < lenupsample; i++)
    {
  	  circular_buffer_upsample[i] = 0;
    }

  /* USER CODE END Init */

  /* Configure the system clock */
  SystemClock_Config();

/* Configure the peripherals common clocks */
  PeriphCommonClock_Config();

  /* USER CODE BEGIN SysInit */

  /* USER CODE END SysInit */

  /* Initialize all configured peripherals */
  MX_GPIO_Init();
  MX_DMA_Init();
  MX_SAI2_Init();
  MX_I2C3_Init();
  /* USER CODE BEGIN 2 */
  /* Reset of WM8994 Audio Codec */
  wm8994_Reset(AUDIO_I2C_ADDRESS);

  /* Initialization of WM8994 Audio Codec */
  wm8994_Init(AUDIO_I2C_ADDRESS, INPUT_DEVICE_INPUT_LINE_1 | OUTPUT_DEVICE_HEADPHONE, 100, AUDIO_FREQUENCY_48K);

  /* Start the process receive DMA */
  HAL_SAI_Receive_DMA(&hsai_BlockB2, (uint8_t*)inputBuffer_LeftRightChannel, INPUT_SAMPLE_SIZE);

  /* Start the process transmit DMA */
  HAL_SAI_Transmit_DMA(&hsai_BlockA2, (uint8_t*)outputBuffer_LeftRightChannel, INPUT_SAMPLE_SIZE);

  /* USER CODE END 2 */

  /* Infinite loop */
  /* USER CODE BEGIN WHILE */
  while (1)
  {
	/* Handle Data of first half of buffer */
	if (whatIsReady == FIRST_HALF_IS_READY){
		HAL_GPIO_WritePin(GPIOA, GPIO_PIN_15, GPIO_PIN_SET);
      /* Read Left Channel Values first */
	  for (int i = 0; i < INPUT_SAMPLE_HALF_SIZE; i += 2){
		outputBuffer_LeftRightChannel[i] = (int16_t)pll((float)inputBuffer_LeftRightChannel[i]);
		outputBuffer_LeftRightChannel[i+1] = (int16_t)input_pll;
	  }
	  /* Read Right Channel Values afterwards */
	  for (int i = 1; i < INPUT_SAMPLE_HALF_SIZE; i += 2){
		//outputBuffer_LeftRightChannel[i] = pll((float)inputBuffer_LeftRightChannel[i]);
	    //outputBuffer_LeftRightChannel[i] = inputBuffer_LeftRightChannel[i];
	  }
	  /* Avoid reading first half again */
	  //set Pin
	  HAL_GPIO_WritePin(GPIOA, GPIO_PIN_15, GPIO_PIN_RESET);
	  whatIsReady = FIRST_HALF_IS_READ;
	}
	/* Handle Data of second half of buffer */
	if (whatIsReady == SECOND_HALF_IS_READY){
	  /* Read Left Channel Values first */
		HAL_GPIO_WritePin(GPIOA, GPIO_PIN_15, GPIO_PIN_SET);
	  for (int i = INPUT_SAMPLE_HALF_SIZE; i < INPUT_SAMPLE_SIZE; i += 2){
		outputBuffer_LeftRightChannel[i] = (int16_t)pll((float)inputBuffer_LeftRightChannel[i]);
		outputBuffer_LeftRightChannel[i+1] = (int16_t)input_pll;
	  }
	  /* Read Right Channel Values afterwards */
	  for (int i = INPUT_SAMPLE_HALF_SIZE + 1; i < INPUT_SAMPLE_SIZE; i += 2){
		//outputBuffer_LeftRightChannel[i] = pll(inputBuffer_LeftRightChannel[i]);
		//outputBuffer_LeftRightChannel[i] = inputBuffer_LeftRightChannel[i];
	  }
	  /* Avoid reading first half again */
	  //reset pin
	  HAL_GPIO_WritePin(GPIOA, GPIO_PIN_15, GPIO_PIN_RESET);
	  whatIsReady = SECOND_HALF_IS_READ;
	}

    /* USER CODE END WHILE */

    /* USER CODE BEGIN 3 */
  }
  /* USER CODE END 3 */
}

/**
  * @brief System Clock Configuration
  * @retval None
  */
void SystemClock_Config(void)
{
  RCC_OscInitTypeDef RCC_OscInitStruct = {0};
  RCC_ClkInitTypeDef RCC_ClkInitStruct = {0};

  /** Configure LSE Drive Capability
  */
  HAL_PWR_EnableBkUpAccess();

  /** Configure the main internal regulator output voltage
  */
  __HAL_RCC_PWR_CLK_ENABLE();
  __HAL_PWR_VOLTAGESCALING_CONFIG(PWR_REGULATOR_VOLTAGE_SCALE1);

  /** Initializes the RCC Oscillators according to the specified parameters
  * in the RCC_OscInitTypeDef structure.
  */
  RCC_OscInitStruct.OscillatorType = RCC_OSCILLATORTYPE_HSE;
  RCC_OscInitStruct.HSEState = RCC_HSE_ON;
  RCC_OscInitStruct.PLL.PLLState = RCC_PLL_ON;
  RCC_OscInitStruct.PLL.PLLSource = RCC_PLLSOURCE_HSE;
  RCC_OscInitStruct.PLL.PLLM = 25;
  RCC_OscInitStruct.PLL.PLLN = 432;
  RCC_OscInitStruct.PLL.PLLP = RCC_PLLP_DIV2;
  RCC_OscInitStruct.PLL.PLLQ = 2;
  if (HAL_RCC_OscConfig(&RCC_OscInitStruct) != HAL_OK)
  {
    Error_Handler();
  }

  /** Activate the Over-Drive mode
  */
  if (HAL_PWREx_EnableOverDrive() != HAL_OK)
  {
    Error_Handler();
  }

  /** Initializes the CPU, AHB and APB buses clocks
  */
  RCC_ClkInitStruct.ClockType = RCC_CLOCKTYPE_HCLK|RCC_CLOCKTYPE_SYSCLK
                              |RCC_CLOCKTYPE_PCLK1|RCC_CLOCKTYPE_PCLK2;
  RCC_ClkInitStruct.SYSCLKSource = RCC_SYSCLKSOURCE_PLLCLK;
  RCC_ClkInitStruct.AHBCLKDivider = RCC_SYSCLK_DIV1;
  RCC_ClkInitStruct.APB1CLKDivider = RCC_HCLK_DIV4;
  RCC_ClkInitStruct.APB2CLKDivider = RCC_HCLK_DIV2;

  if (HAL_RCC_ClockConfig(&RCC_ClkInitStruct, FLASH_LATENCY_7) != HAL_OK)
  {
    Error_Handler();
  }
}

/**
  * @brief Peripherals Common Clock Configuration
  * @retval None
  */
void PeriphCommonClock_Config(void)
{
  RCC_PeriphCLKInitTypeDef PeriphClkInitStruct = {0};

  /** Initializes the peripherals clock
  */
  PeriphClkInitStruct.PeriphClockSelection = RCC_PERIPHCLK_SAI2;
  PeriphClkInitStruct.PLLSAI.PLLSAIN = 344;
  PeriphClkInitStruct.PLLSAI.PLLSAIR = 2;
  PeriphClkInitStruct.PLLSAI.PLLSAIQ = 7;
  PeriphClkInitStruct.PLLSAI.PLLSAIP = RCC_PLLSAIP_DIV2;
  PeriphClkInitStruct.PLLSAIDivQ = 1;
  PeriphClkInitStruct.PLLSAIDivR = RCC_PLLSAIDIVR_2;
  PeriphClkInitStruct.Sai2ClockSelection = RCC_SAI2CLKSOURCE_PLLSAI;
  if (HAL_RCCEx_PeriphCLKConfig(&PeriphClkInitStruct) != HAL_OK)
  {
    Error_Handler();
  }
}

/**
  * @brief I2C3 Initialization Function
  * @param None
  * @retval None
  */
static void MX_I2C3_Init(void)
{

  /* USER CODE BEGIN I2C3_Init 0 */

  /* USER CODE END I2C3_Init 0 */

  /* USER CODE BEGIN I2C3_Init 1 */

  /* USER CODE END I2C3_Init 1 */
  hi2c3.Instance = I2C3;
  hi2c3.Init.Timing = 0x20404768;
  hi2c3.Init.OwnAddress1 = 0;
  hi2c3.Init.AddressingMode = I2C_ADDRESSINGMODE_7BIT;
  hi2c3.Init.DualAddressMode = I2C_DUALADDRESS_DISABLE;
  hi2c3.Init.OwnAddress2 = 0;
  hi2c3.Init.OwnAddress2Masks = I2C_OA2_NOMASK;
  hi2c3.Init.GeneralCallMode = I2C_GENERALCALL_DISABLE;
  hi2c3.Init.NoStretchMode = I2C_NOSTRETCH_DISABLE;
  if (HAL_I2C_Init(&hi2c3) != HAL_OK)
  {
    Error_Handler();
  }

  /** Configure Analogue filter
  */
  if (HAL_I2CEx_ConfigAnalogFilter(&hi2c3, I2C_ANALOGFILTER_ENABLE) != HAL_OK)
  {
    Error_Handler();
  }

  /** Configure Digital filter
  */
  if (HAL_I2CEx_ConfigDigitalFilter(&hi2c3, 0) != HAL_OK)
  {
    Error_Handler();
  }
  /* USER CODE BEGIN I2C3_Init 2 */

  /* USER CODE END I2C3_Init 2 */

}

/**
  * @brief SAI2 Initialization Function
  * @param None
  * @retval None
  */
static void MX_SAI2_Init(void)
{

  /* USER CODE BEGIN SAI2_Init 0 */

  /* USER CODE END SAI2_Init 0 */

  /* USER CODE BEGIN SAI2_Init 1 */

  /* USER CODE END SAI2_Init 1 */
  hsai_BlockA2.Instance = SAI2_Block_A;
  hsai_BlockA2.Init.Protocol = SAI_FREE_PROTOCOL;
  hsai_BlockA2.Init.AudioMode = SAI_MODEMASTER_TX;
  hsai_BlockA2.Init.DataSize = SAI_DATASIZE_16;
  hsai_BlockA2.Init.FirstBit = SAI_FIRSTBIT_MSB;
  hsai_BlockA2.Init.ClockStrobing = SAI_CLOCKSTROBING_RISINGEDGE;
  hsai_BlockA2.Init.Synchro = SAI_ASYNCHRONOUS;
  hsai_BlockA2.Init.OutputDrive = SAI_OUTPUTDRIVE_ENABLE;
  hsai_BlockA2.Init.NoDivider = SAI_MASTERDIVIDER_ENABLE;
  hsai_BlockA2.Init.FIFOThreshold = SAI_FIFOTHRESHOLD_EMPTY;
  hsai_BlockA2.Init.AudioFrequency = SAI_AUDIO_FREQUENCY_48K;
  hsai_BlockA2.Init.SynchroExt = SAI_SYNCEXT_DISABLE;
  hsai_BlockA2.Init.MonoStereoMode = SAI_STEREOMODE;
  hsai_BlockA2.Init.CompandingMode = SAI_NOCOMPANDING;
  hsai_BlockA2.Init.TriState = SAI_OUTPUT_NOTRELEASED;
  hsai_BlockA2.FrameInit.FrameLength = 64;
  hsai_BlockA2.FrameInit.ActiveFrameLength = 32;
  hsai_BlockA2.FrameInit.FSDefinition = SAI_FS_CHANNEL_IDENTIFICATION;
  hsai_BlockA2.FrameInit.FSPolarity = SAI_FS_ACTIVE_LOW;
  hsai_BlockA2.FrameInit.FSOffset = SAI_FS_BEFOREFIRSTBIT;
  hsai_BlockA2.SlotInit.FirstBitOffset = 0;
  hsai_BlockA2.SlotInit.SlotSize = SAI_SLOTSIZE_DATASIZE;
  hsai_BlockA2.SlotInit.SlotNumber = 4;
  hsai_BlockA2.SlotInit.SlotActive = 0x00000005;
  if (HAL_SAI_Init(&hsai_BlockA2) != HAL_OK)
  {
    Error_Handler();
  }
  hsai_BlockB2.Instance = SAI2_Block_B;
  hsai_BlockB2.Init.Protocol = SAI_FREE_PROTOCOL;
  hsai_BlockB2.Init.AudioMode = SAI_MODESLAVE_RX;
  hsai_BlockB2.Init.DataSize = SAI_DATASIZE_16;
  hsai_BlockB2.Init.FirstBit = SAI_FIRSTBIT_MSB;
  hsai_BlockB2.Init.ClockStrobing = SAI_CLOCKSTROBING_RISINGEDGE;
  hsai_BlockB2.Init.Synchro = SAI_SYNCHRONOUS;
  hsai_BlockB2.Init.OutputDrive = SAI_OUTPUTDRIVE_DISABLE;
  hsai_BlockB2.Init.FIFOThreshold = SAI_FIFOTHRESHOLD_EMPTY;
  hsai_BlockB2.Init.SynchroExt = SAI_SYNCEXT_DISABLE;
  hsai_BlockB2.Init.MonoStereoMode = SAI_STEREOMODE;
  hsai_BlockB2.Init.CompandingMode = SAI_NOCOMPANDING;
  hsai_BlockB2.Init.TriState = SAI_OUTPUT_NOTRELEASED;
  hsai_BlockB2.FrameInit.FrameLength = 64;
  hsai_BlockB2.FrameInit.ActiveFrameLength = 32;
  hsai_BlockB2.FrameInit.FSDefinition = SAI_FS_CHANNEL_IDENTIFICATION;
  hsai_BlockB2.FrameInit.FSPolarity = SAI_FS_ACTIVE_LOW;
  hsai_BlockB2.FrameInit.FSOffset = SAI_FS_BEFOREFIRSTBIT;
  hsai_BlockB2.SlotInit.FirstBitOffset = 0;
  hsai_BlockB2.SlotInit.SlotSize = SAI_SLOTSIZE_DATASIZE;
  hsai_BlockB2.SlotInit.SlotNumber = 4;
  hsai_BlockB2.SlotInit.SlotActive = 0x00000005;
  if (HAL_SAI_Init(&hsai_BlockB2) != HAL_OK)
  {
    Error_Handler();
  }
  /* USER CODE BEGIN SAI2_Init 2 */

  /* USER CODE END SAI2_Init 2 */

}

/**
  * Enable DMA controller clock
  */
static void MX_DMA_Init(void)
{

  /* DMA controller clock enable */
  __HAL_RCC_DMA2_CLK_ENABLE();

  /* DMA interrupt init */
  /* DMA2_Stream4_IRQn interrupt configuration */
  HAL_NVIC_SetPriority(DMA2_Stream4_IRQn, 0, 0);
  HAL_NVIC_EnableIRQ(DMA2_Stream4_IRQn);
  /* DMA2_Stream6_IRQn interrupt configuration */
  HAL_NVIC_SetPriority(DMA2_Stream6_IRQn, 0, 0);
  HAL_NVIC_EnableIRQ(DMA2_Stream6_IRQn);

}

/**
  * @brief GPIO Initialization Function
  * @param None
  * @retval None
  */
static void MX_GPIO_Init(void)
{
  GPIO_InitTypeDef GPIO_InitStruct = {0};

  /* GPIO Ports Clock Enable */
  __HAL_RCC_GPIOA_CLK_ENABLE();
  __HAL_RCC_GPIOI_CLK_ENABLE();
  __HAL_RCC_GPIOG_CLK_ENABLE();
  __HAL_RCC_GPIOC_CLK_ENABLE();
  __HAL_RCC_GPIOH_CLK_ENABLE();

  /*Configure GPIO pin Output Level */
  HAL_GPIO_WritePin(GPIOA, GPIO_PIN_15, GPIO_PIN_RESET);

  /*Configure GPIO pin Output Level */
  HAL_GPIO_WritePin(GPIOI, GPIO_PIN_2, GPIO_PIN_RESET);

  /*Configure GPIO pin : PA15 */
  GPIO_InitStruct.Pin = GPIO_PIN_15;
  GPIO_InitStruct.Mode = GPIO_MODE_OUTPUT_PP;
  GPIO_InitStruct.Pull = GPIO_NOPULL;
  GPIO_InitStruct.Speed = GPIO_SPEED_FREQ_LOW;
  HAL_GPIO_Init(GPIOA, &GPIO_InitStruct);

  /*Configure GPIO pin : PI2 */
  GPIO_InitStruct.Pin = GPIO_PIN_2;
  GPIO_InitStruct.Mode = GPIO_MODE_OUTPUT_PP;
  GPIO_InitStruct.Pull = GPIO_NOPULL;
  GPIO_InitStruct.Speed = GPIO_SPEED_FREQ_LOW;
  HAL_GPIO_Init(GPIOI, &GPIO_InitStruct);

}

/* USER CODE BEGIN 4 */
void AUDIO_IO_Write(uint8_t Addr, uint16_t Reg, uint16_t Value){
	uint16_t temp = Value;

	Value = ((uint16_t)(temp >> 8) & 0x00FF);
	Value |= ((uint16_t)(temp << 8) & 0xFF00);

	HAL_I2C_Mem_Write(&hi2c3, Addr, (uint16_t)Reg, I2C_MEMADD_SIZE_16BIT, (uint8_t*)&Value, 2, 1000);
}

uint16_t AUDIO_IO_Read(uint8_t Addr, uint16_t Reg){
	uint16_t read_value = 0;
	uint16_t tmp = 0;

	HAL_I2C_Mem_Read(&hi2c3, Addr, (uint16_t)Reg, I2C_MEMADD_SIZE_16BIT, (uint8_t*)&read_value, 2, 1000);

	tmp = ((uint16_t)(read_value >> 8) & 0x00FF);
	tmp |= ((uint16_t)(read_value << 8) & 0xFF00);

	read_value = tmp;

	return read_value;
}

void AUDIO_IO_Delay(uint32_t Delay){
	HAL_Delay(Delay);
}

void HAL_SAI_TxHalfCpltCallback(SAI_HandleTypeDef *hsai){
	whatIsReady = FIRST_HALF_IS_READY;
	HAL_GPIO_WritePin(GPIOI, GPIO_PIN_2, GPIO_PIN_SET);
	//HAL_GPIO_WritePin(GPIOA, GPIO_PIN_15, GPIO_PIN_SET);
}

void HAL_SAI_TxCpltCallback(SAI_HandleTypeDef *hsai){
	whatIsReady = SECOND_HALF_IS_READY;
	HAL_GPIO_WritePin(GPIOI, GPIO_PIN_2, GPIO_PIN_RESET);
	//HAL_GPIO_WritePin(GPIOA, GPIO_PIN_15, GPIO_PIN_SET);
}

float pll(float input)
{
	//return input;
    float buffer;
    static float last_value = 0;
    float buffer_real = input * lut_cos_6[lut_ptr_6];           //Modulieren (Realteil!)
    float buffer_imag = input * lut_sin_6[lut_ptr_6];           //Modulieren (Imaginärteil!)
    lut_ptr_6 = (lut_ptr_6 + 1) % 6;                            //Pointer (Indizierer) hochzählen und bei bedarf zurücketzen
    buffer_real = conv_fir_2k_real(buffer_real);                //Hier werden zwei Funktionen (wenigstens zwei Circulare Buffer - Real und Imag) benötigt
    buffer_imag = conv_fir_2k_imag(buffer_imag);

    //sieht oke
    /*buffer = abs(buffer_real, buffer_imag);
	buffer_real = buffer * lut_cos_48[lut_ptr_48];      //Eine Mul. öangt, da buffer ein reelles Signal ist
	buffer_imag = buffer * -lut_sin_48[lut_ptr_48];     //Sollte gehen, da der Sinus Punktsymmetrisch ist! -normal ist die Freq. negativ, nicht der ganze Term
	buffer_real = conv_fir_200_real(buffer_real);
	buffer_imag = conv_fir_200_imag(buffer_imag);
	buffer_real = buffer_real * lut_cos_48[lut_ptr_48] - buffer_imag * lut_sin_48[lut_ptr_48];
	lut_ptr_48 = (lut_ptr_48 + 1) % 48;
	return buffer_real;*/


    if (pointer_down_sample == 0)                                   //Alle vier Aufrufe ausführen (Berechnungen für downgesampelte Daten) - funktioniert
    {
        //Mit down_sample[0] weiterrechnen - anderen 3 Werte wegwerfen!
        //Eventuell alles hier Reell - damit wär Rechendauer ca. halb so lang!
        //Geht auch ab hier mit reeller Modulation (siehe Matlab) - doch nicht - in Matlab mit fs verschoben anstatt fest mit 1k Hz
        //Passt doch nicht mit Realteilbildung, da sich das Spektrum überlagert - in Matlab haben wir um fs verschoben, daher was das unproblematisch in Matlab! Hier verschieben wir fest um 1k Hz
        //In Doku erwähnen, dass wir nur real modulieren wollten
        buffer = abs(buffer_real, buffer_imag);
        buffer_real = buffer * lut_cos_48[lut_ptr_48];      //Eine Mul. öangt, da buffer ein reelles Signal ist
        buffer_imag = buffer * -lut_sin_48[lut_ptr_48];     //Sollte gehen, da der Sinus Punktsymmetrisch ist! -normal ist die Freq. negativ, nicht der ganze Term
        buffer_real = conv_fir_200_real(buffer_real);
        buffer_imag = conv_fir_200_imag(buffer_imag);
        //(a+jb)*(c+jd) = ac-bd + j(ad+bc)
        buffer = buffer_real * lut_cos_48[lut_ptr_48] - buffer_imag * lut_sin_48[lut_ptr_48];
        //buffer_imag = buffer_imag * lut_cos_48[lut_ptr_48] + buffer_real * lut_sin_48[lut_ptr_48];  //Wird Wahrscheinlich nicht benötigt
        lut_ptr_48 = (lut_ptr_48 + 4) % 48;
        //buffer = conv_fir_upsample(buffer);

        //Nur zum Oszi bild anschauen
        input_pll = buffer;
        //Erst PLL, dann Upsamplen
        lut_ptr_pll = (int)((lut_ptr_pll + lut_pll_step) - (100 * phi));// % 12000;

        if(lut_ptr_pll > 6000)
        {
        	lut_ptr_pll = lut_ptr_pll - 6000;
        	if (inSecondHalf)
        	{
        		inSecondHalf = 0;
        	}
        	else
        	{
        		inSecondHalf = 1;
        	}
        }
		if (last_value <= 0 && buffer > 0)
		{
			if(inSecondHalf)
			{
				phi = -lut_sin_6k[lut_ptr_pll];
			}
			else
			{
				phi = lut_sin_6k[lut_ptr_pll];
			}
		}
        last_value = buffer;
        //Upsampling Filter den Wert übergeben!
        if(inSecondHalf)
        {
        	buffer = conv_fir_upsample(-lut_sin_6k[lut_ptr_pll] * 25000.0);
        }
        else
        {
        	buffer = conv_fir_upsample(lut_sin_6k[lut_ptr_pll] * 25000.0);
        }
    }
    else
    {
        //Upsampling Filter eine 0 übergeben!
        buffer = conv_fir_upsample(0);
    }
    pointer_down_sample = (pointer_down_sample + 1) % down_len;     //Pointer inkrementieren - Wertebereich [0:3]
    return buffer;//lut_sin_6k[3000] * 5000.0;//test;//buffer;
}


float abs(float real, float imag)
{
    return ((real*real) + (imag*imag)) / 1024;
}

float conv_fir_2k_real(float new_sample)
{
    circular_buffer_2k_real[pointer_2k_real] = new_sample;
    pointer_2k_real = (pointer_2k_real + 1) % len2k;
    int diff = len2k - pointer_2k_real;
    float y = 0;
    for (int i = pointer_2k_real; i < len2k; i++)
    {
        y += (fir_2k[i - pointer_2k_real] * circular_buffer_2k_real[i]);
    }
    for (int i = 0; i < pointer_2k_real; i++)
    {
        y += (fir_2k[i + diff] * circular_buffer_2k_real[i]);
    }
    return y;
}

float conv_fir_2k_imag(float new_sample)
{
    circular_buffer_2k_imag[pointer_2k_imag] = new_sample;
    pointer_2k_imag = (pointer_2k_imag + 1) % len2k;
    int diff = len2k - pointer_2k_imag;
    float y = 0;
    for (int i = pointer_2k_imag; i < len2k; i++)
    {
        y += (fir_2k[i - pointer_2k_imag] * circular_buffer_2k_imag[i]);
    }
    for (int i = 0; i < pointer_2k_imag; i++)
    {
        y += (fir_2k[i + diff] * circular_buffer_2k_imag[i]);
    }
    return y;
}

//Geht - Filter ist symmetrisch!
float conv_fir_200_real(float new_sample)
{
    circular_buffer_200_real[pointer_200_real] = new_sample;
    pointer_200_real = (pointer_200_real + 1) % len200;
    int diff = len200 - pointer_200_real;
    float y = 0;
    for (int i = pointer_200_real; i < len200; i++)
    {
        y += (fir_200[i - pointer_200_real] * circular_buffer_200_real[i]);
    }
    for (int i = 0; i < pointer_200_real; i++)
    {
        y += (fir_200[i + diff] * circular_buffer_200_real[i]);
    }
    return y;
}

float conv_fir_200_imag(float new_sample)
{
    circular_buffer_200_imag[pointer_200_imag] = new_sample;
    pointer_200_imag = (pointer_200_imag + 1) % len200;
    int diff = len200 - pointer_200_imag;
    float y = 0;
    for (int i = pointer_200_imag; i < len200; i++)
    {
        y += (fir_200[i - pointer_200_imag] * circular_buffer_200_imag[i]);
    }
    for (int i = 0; i < pointer_200_imag; i++)
    {
        y += (fir_200[i + diff] * circular_buffer_200_imag[i]);
    }
    return y;
}

//Geht - Filter ist symmetrisch!
float conv_fir_upsample(float new_sample)
{
    circular_buffer_upsample[pointer_upsample] = new_sample;
    pointer_upsample = (pointer_upsample + 1) % lenupsample;
    int diff = lenupsample - pointer_upsample;
    float y = 0;
    for (int i = pointer_upsample; i < lenupsample; i++)
    {
        y += (fir_upsample[i - pointer_upsample] * circular_buffer_upsample[i]);
    }
    for (int i = 0; i < pointer_upsample; i++)
    {
        y += (fir_upsample[i + diff] * circular_buffer_upsample[i]);
    }
    return y;
}

/* USER CODE END 4 */

/**
  * @brief  This function is executed in case of error occurrence.
  * @retval None
  */
void Error_Handler(void)
{
  /* USER CODE BEGIN Error_Handler_Debug */
  /* User can add his own implementation to report the HAL error return state */
  __disable_irq();
  while (1)
  {
  }
  /* USER CODE END Error_Handler_Debug */
}

#ifdef  USE_FULL_ASSERT
/**
  * @brief  Reports the name of the source file and the source line number
  *         where the assert_param error has occurred.
  * @param  file: pointer to the source file name
  * @param  line: assert_param error line source number
  * @retval None
  */
void assert_failed(uint8_t *file, uint32_t line)
{
  /* USER CODE BEGIN 6 */
  /* User can add his own implementation to report the file name and line number,
     ex: printf("Wrong parameters value: file %s on line %d\r\n", file, line) */
  /* USER CODE END 6 */
}
#endif /* USE_FULL_ASSERT */
